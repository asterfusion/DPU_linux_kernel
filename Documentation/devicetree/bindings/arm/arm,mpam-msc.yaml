## Documentation/devicetree/bindings/arm/arm,mpam-msc.yaml
```yaml
# SPDX-License-Identifier: GPL-2.0 OR BSD-2-Clause
%YAML 1.2
---
$id: http://devicetree.org/schemas/arm/arm,mpam-msc.yaml#
$schema: http://devicetree.org/meta-schemas/core.yaml#

title: ARM MPAM

maintainers:
  - Rob Herring <robh@kernel.org>

properties:
  compatible:
    const: arm,mpam-msc    # Further details are discoverable

  reg:
    maxItems: 1

  interrupts:
    minItems: 1
    maxItems: 2
    items:
      - description: error (optional)
      - description: overflow (only for monitoring)

  interrupt-names:
    oneOf:
      - items:
          - enum: [ error, overflow ]
      - items:
          - const: error
          - const: overflow

  arm,max-nrdy-usec:
    description: |
      The maximum time that any coutner in the MSC's NRDY bit may be 1.

  numa-node-id: true # see NUMA binding

patternProperties:
  '^ris@[0-9a-f]$':
    type: object
    description: |
      RIS nodes for each RIS in an MSC. These nodes are only necessary if the
      MSC and its RISs are not associated with the MSC parent device. IOW, the
      RIS nodes are only needed if associated with different components in the
      memory system hierarchy.

      A possible exception would be if we need to associate each RIS with an
      component of the parent device. For example, which devices or TBU for an
      IOMMU are associated with a RIS and this can't be implied by the parent
      device.

    properties:
      reg:
        minimum: 0
        maximum: 15

      cpus:
        $ref: '/schemas/types.yaml#/definitions/phandle'
        description:
          A phandle to the CPU node this RIS belongs to.

      # Note 'cpus' is already established for CPU affinity phandles. For the
      # other types, MPAM specific names or not???
      arm,mpam-cache:
        $ref: '/schemas/types.yaml#/definitions/phandle'
        description:
          A phandle to the cache node this RIS belongs to.

      arm,mpam-iommu:
        $ref: '/schemas/types.yaml#/definitions/phandle'
        description:
          A phandle to the IOMMU node this RIS belongs to.

      arm,mpam-memory:
        $ref: '/schemas/types.yaml#/definitions/phandle'
        description:
          A phandle to the memory node this RIS belongs to.

required:
  - compatible
  - reg

additionalProperties: false

examples:
  - |
    cpus {
        cpu@0 {
            next-level-cache = <&L2_0>;
        };
        cpu@100 {
            next-level-cache = <&L2_1>;
        };
    };

    L2_0: cache-controller {
        compatible = "cache";
        cache-level = <2>;

        power-domains = <&pdc 1>;

        msc@1000 {
            compatible = "arm,mpam-msc";

            /* CPU affinity implied by cache association with cpu@0 */
            reg = <0x1000 0x1000>;
            interrupts = <1>, <2>;
            interrupt-names = "error", "overflow";
            arm,max-nrdy-usec = <1>;
        };
    };

    mem: memory-controller@20000 {
        reg = <0x20000 0x1000>;
        ranges;

        msc@21000 {
            compatible = "arm,mpam-msc";
            reg = <0x21000 0x1000>;
            interrupts = <3>;
            interrupt-names = "error";
            arm,max-nrdy-usec = <1>;
            numa-node-id = <1>;
        };
    };

    iommu@40000 {
        reg = <0x40000 0x1000>;
        ranges;

        msc@41000 {
            compatible = "arm,mpam-msc";
            reg = <0 0x1000>;
            interrupts = <5>, <6>;
            interrupt-names = "error", "overflow";
            arm,max-nrdy-usec = <1>;

            ris@0 {
                reg = <0>;
                // How to map to device(s)?
            };

        };
    };

    msc@80000 {
        compatible = "partner,a-standalone-msc", "arm,mpam-msc";
        reg = <0 0x80000>;
        interrupts = <7>, <8>;

        clocks = <&clks 123>;

        ris@0 {
            reg = <0>;
            arm,msc-cache = <&L2_0>;
        };

        ris@1 {
            reg = <1>;
            arm,msc-memory = <&mem>;
        };

    };

...
```

## Documentation/devicetree/bindings/arm/marvell/cn913x.txt
```
Marvell OcteonTX2 CN913X Platforms Device Tree Bindings
-------------------------------------------------------

Boards using a SoC of the Marvell CN913X families must carry the following
root node property:

 - compatible, with one of the following values:

SoC:
   - "marvell,cn9130", "marvell,armada-ap807-quad", "marvell,armada-ap807"
      when the SoC being used is the CN9130

Boards:
   - "marvell,cn9130-db-A", "marvell,cn9130-db-B", "marvell,cn9130-db-C",
     "marvell,cn9130-db-D"
      when the board being used is the OcteonTX2 CN9130 Development board with
      Setup A, B, C or D.

   - "marvell,cn9130-crb-A", "marvell,cn9130-crb-B", "marvell,cn9130-crb-C"
      when the board being used is the OcteonTX2 CN9130 crb board with Setup A,
      B or C.

   - "marvell,cn9131-db-A", "marvell,cn9131-db-B", "marvell,cn9131-db-C",
     "marvell,cn9131-db-D"
      when the board being used is the OcteonTX2 CN9131 Development board with
      Setup A, B, C or D.

   - "marvell,cn9132-db-A", "marvell,cn9132-db-B", "marvell,cn9132-db-D",
     "marvell,cn9132-db" when the board being used is the OcteonTX2 CN9132
     Development board with Setup A, B or D.

Example:

compatible = "marvell,cn9131-db-A", "marvell,cn9131-db",
	     "marvell,armada-ap807-quad", "marvell,armada-ap807";
```

## Documentation/devicetree/bindings/edac/armada-ap80x-edac.txt
```
Marvell Armada AP80x-based SoCs EDAC nodes
==========================================

EDAC memory controller node:
----------------------------
Armada AP80x memory controller supports 8-bit ECC for 64-/32-bit bus
widths using SECDED (Single bit Error Correction, Double bit Error
Detection) algorithm.

The memory controller EDAC driver works with memory modules with
ECC and reliably reports about correctable ECC 1-bit errors.

Uncorrectable ECC 2-bit errors, in addition to the ECC interrupt,
generate an exception. This exception may result in the system's
crash preventing EDAC subsystem correctly capture and report.

Required properties:
- compatible	: Must be "marvell,armada-ap80x-edac-mc"
- reg		: The device register area
- interrupts	: The interrupt definition

Example:
	edac_mc: edac-mc@20000 {
		compatible = "marvell,armada-ap80x-edac-mc";
		reg = <0x20000 0x1000>;
		interrupts = <GIC_SPI 5 IRQ_TYPE_LEVEL_HIGH>;
		status = "okay";
	};
```

## Documentation/devicetree/bindings/mmc/cavium-mmc.txt
```
* Cavium Octeon & ThunderX MMC controller

The highspeed MMC host controller on Caviums SoCs provides an interface
for MMC and SD types of memory cards.

Supported maximum speeds are the ones of the eMMC standard 4.41 as well
as the speed of SD standard 4.0. Only 3.3 Volt is supported.

Required properties:
 - compatible : should be one of:
   cavium,octeon-6130-mmc
   cavium,octeon-7890-mmc
   cavium,thunder-8190-mmc
   cavium,thunder-8390-mmc
   mmc-slot
 - reg : mmc controller base registers
 - clocks : phandle

Optional properties:
 - for cd, bus-width, vmmc-supply, vqmmc-supply, and additional generic
   mmc parameters please refer to mmc.txt within this directory
 - cavium,cmd-clk-skew : number of coprocessor clocks before sampling command
 - cavium,dat-clk-skew : number of coprocessor clocks before sampling data
 - cavium,drv-strength : eMMC bus pin output drive strength
 - cavium,clk-slew     : eMMC bus pins output slew rate control
 - marvell,hs200-tap-adjust : offset to use from the calculated HS200 tap for
			 data input.  This is a signed value.  Default is 0.
 - marvell,hs400-tap-adjust : offset to use from the calculated HS400 tap for
                         data input if HS400 tuning is enabled.  Default is 0.
 - marvell,hs400-tuning-block : If set this enables HS400 tuning and specifies
			 the block number to use.  Note that this block number
			 WILL be overwritten to contain the tuning pattern if
			 it is not already present, even if this block falls
			 into a partition.  Typically block 1 is chosen which
			 may cause issues with EFI partitioning.  If EFI
			 partitioning is used then this block should be
			 changed.
 - marvell,cmd-out-hs200-dly:	Hold time delay in picoseconds for the command
				signal in HS200 mode.  The default is 800ps.
 - marvell,data-out-hs200-dly:	Hold time delay in picoseconds for the data
				signal in HS200 mode.  The default is 800ps.
 - marvell,cmd-out-hs400-dly:	Hold time delay in picoseconds for the command
				signal in HS400 mode.  The default is 800ps.
 - marvell,data-out-hs400-dly:	Hold time delay in picoseconds for the data
				signal in HS400 mode.  The default is 400ps.

Deprecated properties:
 - spi-max-frequency : use max-frequency instead
 - cavium,bus-max-width : use bus-width instead
 - power-gpios : use vmmc-supply instead
 - cavium,octeon-6130-mmc-slot : use mmc-slot instead

GPIO control via vmmc-supply & vqmmc-supply:
  Two types of regulator object can be specified as mmc properties,
  typically regulator-fixed controlled by GPIO pins.

  Octeon/OcteonTX chips commonly use GPIO8 as an MMC-reset pin.
  In systems which may boot from MMC, it starts as input, and is gently
  pulled up/down by board logic to indicate the active sense of the
  signal. Chip reset then drives the signal in the opposite direction
  to effect a reset of target devices.
  Device tree should model this with a vmmc-supply regulator, gated by
  GPIO8, so GPIO8 is driven in the non-reset direction when MMC devices
  are probed, and held there until rmmod/shutdown/suspend.
  This allows a warm reboot to reset the MMC devices.

  Octeon/OcteonTX MMC supports up to 3 mmc slots, but any
  level-shifting to accommodate different signal voltages is
  done by external hardware, under control of an optional
  vqmmc regulator object, typically controlled by GPIO.

  If any mmc-slots have a vqmmc-supply property, it is taken as a warning
  that we must switch carefully between slots (unless they have the same
  vqmmc object), tri-stating MMC signals to avoid any transient states
  as level-shifters are enabled/disabled.

  Even when so-called bi-directional level shifters are used,
  this technique should be employed when using different bus-widths
  on different slots, disabling level shifters to avoid presenting
  non-uniform impedance across DATA0-7 & CMD when non-selected
  4-wide slots are left enabled, while accessing 8-wide targets.

  Note that it's not possible to specify multiple regulators
  controlled by same GPIO pin, but with different active state.
  If one GPIO line is require to switch voltage/routing between
  different mmc-slots, specify a vqmmc-supply on one slot, but
  not the other. The regulator_disable call on leaving that slot
  will implicitly switch the state to support the unmarked slot.

  There's no need to list vqmmc-supply if all the mmc-slots on
  a board run at same voltage, and have same width.

Tuning support:
  Tuning is required for eMMC for HS200 and HS400 modes to work properly.
  The eMMC specification only provides a means of performing tuning in
  HS200 mode but in many cases this causes reliability issues in HS400
  mode.  In order to tune in HS400 mode a block must be set aside where
  a tuning pattern will be written once then read with each data input
  tap value to choose the best tap value.  HS400 tuning is optional though
  it is recommended.  Offsets to the chosen tuning value may also be
  specified but in general these should not be needed.

  cavium,cmd-clk-skew and cavium,dat-clk-skew are not used for OcteonTX2
  and later devices.

Examples:
	mmc_1_4: mmc@1,4 {
		compatible = "cavium,thunder-8390-mmc";
		reg = <0x0c00 0 0 0 0>;	/* DEVFN = 0x0c (1:4) */
		#address-cells = <1>;
		#size-cells = <0>;
		clocks = <&sclk>;

		mmc-slot@0 {
			compatible = "mmc-slot";
			reg = <0>;
			vmmc-supply = <&mmc_supply_3v3>;
			vqmmc-supply = <&vqmmc_3v3>;
			max-frequency = <52000000>;
			bus-width = <4>;
			cap-sd-highspeed;
		};

		mmc-slot@1 {
			compatible = "mmc-slot";
			reg = <1>;
			vmmc-supply = <&mmc_supply_1v8>;
			vqmmc-supply = <&vqmmc_1v8>;
			max-frequency = <100000000>;
			bus-width = <8>;
			cap-mmc-highspeed;
			non-removable;
			mmc-hs200-1_8v;
			mmc-hs400-1_8v;
			marvell,hs400-tuning-block = <1>;
		};
	};
```
